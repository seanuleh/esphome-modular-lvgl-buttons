## airmouse-standalone/esp-idf/sdkconfig.defaults
```kconfig
# ESP32-S3 target
CONFIG_IDF_TARGET="esp32s3"

# Bluetooth
CONFIG_BT_ENABLED=y
CONFIG_BT_NIMBLE_ENABLED=y
CONFIG_BT_NIMBLE_HID_SERVICE=y
CONFIG_BT_NIMBLE_MAX_CONNECTIONS=1
CONFIG_BT_NIMBLE_ROLE_CENTRAL=n
CONFIG_BT_NIMBLE_ROLE_OBSERVER=n

# Reduce BLE memory footprint
CONFIG_BT_NIMBLE_MEM_ALLOC_MODE_INTERNAL=y

# USB CDC for console (ESP32-S3)
CONFIG_ESP_CONSOLE_USB_CDC=y

# I2C
CONFIG_I2C_ISR_IRAM_SAFE=n

# Log level
CONFIG_LOG_DEFAULT_LEVEL_INFO=y

# FreeRTOS
CONFIG_FREERTOS_HZ=1000

# Partition table
CONFIG_PARTITION_TABLE_SINGLE_APP=y
```
